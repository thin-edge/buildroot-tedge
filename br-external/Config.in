## br-external/package/thin-edge/Config.in
```kconfig
config BR2_PACKAGE_THIN_EDGE
	bool "thin-edge"
    depends on BR2_PACKAGE_SYSTEMD
    depends on BR2_PACKAGE_SUDO
    depends on BR2_PACKAGE_MOSQUITTO
    depends on BR2_PACKAGE_GLIBC_UTILS
    depends on BR2_PACKAGE_LIBXCRYPT
    select BR2_PACKAGE_CA_CERTIFICATES
	help
      thin-edge.io is an open-source development toolbox designed
      for rapid development of IoT agents. It is based on a 
      versatile set of ready-to-use software components that
      can be easily combined with application-specific extensions
      into smart, secure, robust and  efficient IoT agents which 
      integrate cloud services, edge computing and operational 
      technologies.

	  https://github.com/thin-edge/thin-edge.io
```
